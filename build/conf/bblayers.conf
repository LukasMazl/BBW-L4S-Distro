## build/conf/bblayers.conf
```bitbake
# POKY_BBLAYERS_CONF_VERSION is increased each time build/conf/bblayers.conf
# changes incompatibly
POKY_BBLAYERS_CONF_VERSION = "2"

BBPATH = "${TOPDIR}"
BBFILES ?= ""

BBLAYERS ?= " \
  /workdir/poky/meta \
  /workdir/poky/meta-poky \
  /workdir/poky/meta-yocto-bsp \
  /workdir/meta-arm/meta-arm-toolchain \
  /workdir/meta-arm/meta-arm \
  /workdir/meta-ti/meta-ti-bsp \
  /workdir/meta-ti/meta-ti-extras \
  /workdir/meta-linux4space \
  /workdir/meta-linux4space-adcs \
  /workdir/meta-openembedded/meta-oe \
  "
```

## meta-linux4space-adcs/conf/layer.conf
```bitbake
# We have a conf and classes directory, add to BBPATH
BBPATH .= ":${LAYERDIR}"

# We have recipes-* directories, add to BBFILES
BBFILES += "${LAYERDIR}/recipes-*/*/*.bb \
            ${LAYERDIR}/recipes-*/*/*.bbappend"

BBFILE_COLLECTIONS += "meta-linux4space-adcs"
BBFILE_PATTERN_meta-linux4space-adcs = "^${LAYERDIR}/"
BBFILE_PRIORITY_meta-linux4space-adcs = "6"

LAYERDEPENDS_meta-linux4space-adcs = "core"
LAYERSERIES_COMPAT_meta-linux4space-adcs = "scarthgap"
```
